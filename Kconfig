## Kconfig
```kconfig
menu "Spatial Library"

    config SPATIAL_STD_FORMAT
        bool "Enable std::format support"
        default y
        help
            Include <format> and provide std::formatter specializations
            for spatial types. Disable if <format> is unavailable or
            undesired.

endmenu
```
